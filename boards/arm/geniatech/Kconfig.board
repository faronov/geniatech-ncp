## boards/arm/geniatech/Kconfig.board
```kconfig
# SPDX-License-Identifier: Apache-2.0

config BOARD_GENIATECH
    bool "Geniatech nRF52840 Zigbee NCP board"
    depends on SOC_NRF52840_QIAA
```

## boards/arm/geniatech/Kconfig.defconf
```kconfig
# SPDX-License-Identifier: Apache-2.0

if BOARD_GENIATECH

config BOARD
    default "geniatech"

config GPIO
    default y

config SERIAL
    default y

config NRFX_UARTE0
    default y

config NRFX_UARTE1
    default y

config FLASH
    default y

config FLASH_MAP
    default y

config IMG_MANAGER
    default y

config PM_SINGLE_IMAGE
    default n

config USB_DEVICE_STACK
    default n

config USB_CDC_ACM
    default n

endif
```

## boards/arm/geniatech/geniatech_defconfig
```kconfig
CONFIG_ARM=y
CONFIG_SOC_SERIES_NRF52X=y
CONFIG_SOC_NRF52840_QIAA=y

CONFIG_BOARD_GENIATECH=y

CONFIG_GPIO=y
CONFIG_SERIAL=y

CONFIG_NRFX_UARTE0=y
CONFIG_NRFX_UARTE1=y

CONFIG_USB_DEVICE_STACK=n
CONFIG_USB_CDC_ACM=n

CONFIG_FLASH=y
CONFIG_FLASH_MAP=y
CONFIG_IMG_MANAGER=y
CONFIG_PM_SINGLE_IMAGE=n
```

## geniatech_defconfig
```kconfig
CONFIG_ARM=y
CONFIG_ARCH_HAS_STACK_PROTECTION=y

CONFIG_SOC_SERIES_NRF52X=y
CONFIG_SOC_NRF52840_QIAA=y

CONFIG_BOARD_GENIATECH=y

CONFIG_GPIO=y
CONFIG_SERIAL=y

# UARTы
CONFIG_NRFX_UARTE0=y
CONFIG_NRFX_UARTE1=y

# Без USB
CONFIG_USB_DEVICE_STACK=n
CONFIG_USB_CDC_ACM=n

# Для MCUboot/PM
CONFIG_FLASH=y
CONFIG_FLASH_MAP=y
CONFIG_IMG_MANAGER=y
CONFIG_PM_SINGLE_IMAGE=n
```
